## firmware/Config.in
```kconfig
source "$BR2_EXTERNAL_FIRMWARE_PATH/package/hello-c/Config.in"
source "$BR2_EXTERNAL_FIRMWARE_PATH/package/hello-cpp/Config.in"
source "$BR2_EXTERNAL_FIRMWARE_PATH/package/periphery/Config.in"
source "$BR2_EXTERNAL_FIRMWARE_PATH/package/hwtools/Config.in"
source "$BR2_EXTERNAL_FIRMWARE_PATH/package/gallery/Config.in"
source "$BR2_EXTERNAL_FIRMWARE_PATH/package/display/Config.in"
source "$BR2_EXTERNAL_FIRMWARE_PATH/package/screen/Config.in"
source "$BR2_EXTERNAL_FIRMWARE_PATH/package/sysdiag/Config.in"
source "$BR2_EXTERNAL_FIRMWARE_PATH/package/usb-cdc/Config.in"
source "$BR2_EXTERNAL_FIRMWARE_PATH/package/networking/Config.in"
source "$BR2_EXTERNAL_FIRMWARE_PATH/package/find-me/Config.in"
source "$BR2_EXTERNAL_FIRMWARE_PATH/package/spinand/Config.in"
source "$BR2_EXTERNAL_FIRMWARE_PATH/package/spinor/Config.in"
source "$BR2_EXTERNAL_FIRMWARE_PATH/package/sdcard/Config.in"
```

## firmware/configs/linux-6.6.151-stm32f429disco.defconfig
```kconfig
BR2_arm=y
BR2_cortex_m4=y
BR2_TOOLCHAIN_EXTERNAL=y
BR2_TOOLCHAIN_EXTERNAL_CUSTOM=y
BR2_TOOLCHAIN_EXTERNAL_DOWNLOAD=y
BR2_TOOLCHAIN_EXTERNAL_URL="file:///workspace/buildroot-sdk/arm-buildroot-uclinux-uclibcgnueabi_sdk-buildroot.tar.gz"
BR2_TOOLCHAIN_EXTERNAL_HEADERS_6_1=y
# BR2_TOOLCHAIN_EXTERNAL_HAS_THREADS_DEBUG is not set
# BR2_TOOLCHAIN_EXTERNAL_HAS_THREADS_NPTL is not set
BR2_TOOLCHAIN_EXTERNAL_CXX=y
BR2_DL_DIR="/workspace/buildroot-downloads"
BR2_ENABLE_LTO=y
BR2_GLOBAL_PATCH_DIR="$(BR2_EXTERNAL_FIRMWARE_PATH)/board/stm32f429disco/patches"
BR2_INIT_NONE=y
# BR2_TARGET_GENERIC_GETTY is not set
BR2_ROOTFS_OVERLAY="/workspace/firmware/board/stm32f429disco/rootfs-minimal-overlay"
BR2_ROOTFS_POST_BUILD_SCRIPT="/workspace/firmware/board/stm32f429disco/post-build.sh"
BR2_LINUX_KERNEL=y
BR2_LINUX_KERNEL_CUSTOM_VERSION=y
BR2_LINUX_KERNEL_CUSTOM_VERSION_VALUE="6.6.151"
BR2_LINUX_KERNEL_USE_CUSTOM_CONFIG=y
BR2_LINUX_KERNEL_CUSTOM_CONFIG_FILE="/workspace/firmware/board/stm32f429disco/linux.config"
BR2_LINUX_KERNEL_IMAGE_TARGET_CUSTOM=y
BR2_LINUX_KERNEL_IMAGE_TARGET_NAME="xipImage"
BR2_LINUX_KERNEL_DTS_SUPPORT=y
BR2_LINUX_KERNEL_CUSTOM_DTS_PATH="/workspace/firmware/board/stm32f429disco/dts/stm32f429disco-unified.dts"
BR2_PACKAGE_BUSYBOX_CONFIG="/workspace/firmware/board/stm32f429disco/busybox.config"
# BR2_PACKAGE_IFUPDOWN_SCRIPTS is not set
BR2_TARGET_ROOTFS_INITRAMFS=y
# BR2_TARGET_ROOTFS_TAR is not set
BR2_TARGET_AFBOOT_STM32=y
BR2_TARGET_AFBOOT_STM32_KERNEL_ADDR=0x0800C000
BR2_PACKAGE_HOST_OPENOCD=y
```

## firmware/package/display/Config.in
```kconfig
config BR2_PACKAGE_DISPLAY
	bool "Display: PNG/JPEG/GIF/BMP slideshow"
	depends on !BR2_PACKAGE_GALLERY_PROVIDES_DISPLAY
	depends on !BR2_PACKAGE_FIRMWARE_SCREEN
	select BR2_PACKAGE_FBV
	select BR2_PACKAGE_FBV_PNG
	select BR2_PACKAGE_FBV_JPEG
	select BR2_PACKAGE_FBV_GIF
	help
	  Enable the STM32F429Discovery LCD and install a small slideshow
	  example. The example uses fbv with PNG, JPEG, and GIF support and
	  includes one 240x320 test image in each format. fbv's built-in BMP
	  support is also available without another decoder library.

	  Selecting this package also applies the required Linux DRM/fbdev
	  configuration fragment. The shared board device tree already describes
	  the display hardware.

	  When this package is not selected, the display drivers, fbv, image
	  decoder libraries, display utility, and sample images are excluded from
	  the firmware image. The device-tree nodes remain inactive because their
	  kernel drivers are not enabled.

	  The independent BR2_PACKAGE_SYSDIAG package may be selected beside
	  this or any other example when reusable diagnostics are needed.

	  Select Gallery for the BusyBox-style executable example. Its optional
	  SD-card suboption combines Display and SD-card applets in that binary.

comment "Standalone Display is disabled by Gallery"
	depends on BR2_PACKAGE_GALLERY

comment "Standalone Display is disabled by Screen"
	depends on BR2_PACKAGE_FIRMWARE_SCREEN

if BR2_PACKAGE_DISPLAY

menu "Display options"

config BR2_PACKAGE_DISPLAY_COMPRESS_INITRAMFS
	bool "Compress the initramfs with gzip (NEW)"
	default y
	help
	  Store the embedded root filesystem as a gzip-compressed archive in
	  internal flash. Linux expands it into RAM during boot; the kernel
	  remains an XIP image and continues executing directly from flash.

config BR2_PACKAGE_DISPLAY_AUTOSTART
	bool "Start the image slideshow automatically at boot"
	default y
	help
	  Install the package-owned /etc/init.d/S30display service. The
	  standalone Display example always uses its bundled test images unless
	  an explicit directory is passed to display.

	  The viewer runs in non-interactive mode and does not consume input
	  from the serial console. Use the service script's status or stop
	  operation before manual framebuffer testing.

endmenu

endif
```

## firmware/package/displaydebug/Config.in
```kconfig
config BR2_PACKAGE_DISPLAYDEBUG
	bool "Reusable kernel and peripheral diagnostics"
	help
	  Install the displaydebug diagnostic command and enable reusable kernel
	  and BusyBox diagnostics. The report includes system information,
	  interrupts, clocks, device nodes, and kernel messages. When the LTDC
	  driver is present, it also reports display clocks and registers.

	  This package is independent of every example. Select it temporarily
	  beside whichever example is being debugged, then disable it to produce
	  the smaller normal image.
```

## firmware/package/displayexample/Config.in
```kconfig
config BR2_PACKAGE_DISPLAYEXAMPLE
	bool "Display example: PNG/JPEG/GIF/BMP slideshow"
	select BR2_PACKAGE_FBV
	select BR2_PACKAGE_FBV_PNG
	select BR2_PACKAGE_FBV_JPEG
	select BR2_PACKAGE_FBV_GIF
	help
	  Enable the STM32F429Discovery LCD and install a small slideshow
	  example. The example uses fbv with PNG, JPEG, and GIF support and
	  includes one 240x320 test image in each format. fbv's built-in BMP
	  support is also available without another decoder library.

	  Selecting this package also applies the required Linux DRM/fbdev
	  configuration fragment and builds a display-enabled device tree.
	  The flash script automatically selects that device tree.

	  When this package is not selected, the display drivers, fbv, image
	  decoder libraries, slideshow script, sample images, and display
	  device-tree nodes are all excluded from the firmware images.
```

## firmware/package/find-me/Config.in
```kconfig
config BR2_PACKAGE_FIND_ME
	bool "find-me"
	select BR2_PACKAGE_NETWORKING
	select BR2_PACKAGE_NETWORKING_W5500
	help
	  Install find-me, a Linux implementation of the FreeRTOS find-me
	  reference target. It enables a W5500 on shared SPI5 with its own
	  chip select, separate from the isolated SPI4 SD-card bus,
	  obtains an IPv4 address, advertises _device-setup._tcp.local over
	  mDNS, and serves the API v3 HTTP/OAuth/WebSocket onboarding flow.

	  The device ID and locally administered MAC address are derived from
	  the STM32 factory unique ID. Optional external confirmation-button
	  and status-LED GPIOs avoid every pin used by the existing examples.

	  Persistent state can use optional filesystem-free CY15B256Q FRAM,
	  24LC16B I2C EEPROM, or W25Q128FV SPI-NOR storage, or a mounted
	  standalone storage package. Runtime detection selects the first
	  available backend and falls back safely to the RAM-backed root
	  filesystem.

if BR2_PACKAGE_FIND_ME

menu "find-me options"

config BR2_PACKAGE_FIND_ME_COMPRESS_INITRAMFS
	bool "Compress the initramfs with gzip (NEW)"
	default y
	help
	  Store the embedded root filesystem as a gzip-compressed archive in
	  internal flash. Linux expands it into RAM during boot; the kernel
	  remains an XIP image and continues executing directly from flash.

config BR2_PACKAGE_FIND_ME_AUTOSTART
	bool "Start find-me automatically at boot"
	default y
	help
	  Install the package-owned find-me service and start it after persistent
	  storage services have completed. The service supports start, stop,
	  restart, and status operations.

config BR2_PACKAGE_FIND_ME_FRAM
	bool "Enable CY15B256Q SPI-FRAM"
	help
	  Enable a Cypress CY15B256Q SPI FRAM on the shared SPI5 bus. It uses
	  PC11 (P1 pin 42) as its dedicated active-low chip select and is
	  exposed by the Linux AT25/NVMEM driver.

	  find-me stores two alternating, checksummed records in the
	  first 512 bytes. If the FRAM is absent or fails to probe, startup
	  continues with mounted storage packages and then RAM.

config BR2_PACKAGE_FIND_ME_EEPROM
	bool "Enable 24LC16B I2C EEPROM"
	help
	  Enable a Microchip 24LC16B on the existing 100 kHz I2C3 bus. Linux's
	  at24 driver exposes its 2 KiB as byte-addressable NVMEM; no filesystem
	  is used. find-me stores two alternating 256-byte records with
	  generation counters, CRC32, and read-back verification.

	  The EEPROM occupies I2C addresses 0x50 through 0x57. It can coexist
	  with SPI-FRAM, SPI-NOR, and mounted storage, and find-me remains
	  the sole writer of its reserved first 512 bytes.

config BR2_PACKAGE_FIND_ME_SPINOR_STATE
	bool "Enable W25Q128FV SPI-NOR"
	help
	  Enable a W25Q128FV on the shared SPI5 bus and reserve its first two
	  4 KiB erase sectors for find-me. State is accessed directly
	  through raw MTD, without a filesystem, and written as alternating
	  records with generation counters, CRC32, and read-back verification.
	  An interrupted erase or write leaves the previous sector usable.

	  This option is independent of the standalone SPI-NOR package. If that
	  package is also selected, it exposes the remaining NOR capacity as an
	  independent JFFS2 filesystem at /mnt/spinor.

config BR2_PACKAGE_FIND_ME_CONSOLE_DEBUG
	bool "Enable console button and LED debug controls"
	help
	  Install find-me-debug for hardware-independent testing from
	  the serial console. Its button command simulates one complete USER
	  button press and its led command runs a three-flash LD3 self-test
	  while reporting LED state changes on the console. The net command
	  prints interface counters, and the daemon reports them every five
	  seconds so failures can be diagnosed even when console input is not
	  available.

	  Leave this disabled in production images. The daemon's debug signal
	  handlers and console messages are omitted when this option is off.

endmenu

endif
```

## firmware/package/find-my-device/Config.in
```kconfig
config BR2_PACKAGE_FIND_MY_DEVICE
	bool "Find My Device: W5500, mDNS, and onboarding API"
	help
	  Install a Linux implementation of the FreeRTOS Find My Device
	  reference target. It enables a W5500 on shared SPI5 with its own
	  chip select, separate from the isolated SPI4 SD-card bus,
	  obtains an IPv4 address, advertises _device-setup._tcp.local over
	  mDNS, and serves the API v3 HTTP/OAuth/WebSocket onboarding flow.

	  The device ID and locally administered MAC address are derived from
	  the STM32 factory unique ID. Optional external confirmation-button
	  and status-LED GPIOs avoid every pin used by the existing examples.

	  Persistent state can use optional filesystem-free CY15B256Q FRAM,
	  24LC16B I2C EEPROM, or W25Q128FV SPI-NOR storage, or a mounted
	  standalone storage package. Runtime detection selects the first
	  available backend and falls back safely to the RAM-backed root
	  filesystem.

if BR2_PACKAGE_FIND_MY_DEVICE

menu "Find My Device options"

config BR2_PACKAGE_FIND_MY_DEVICE_FRAM
	bool "Enable CY15B256Q SPI-FRAM"
	help
	  Enable a Cypress CY15B256Q SPI FRAM on the shared SPI5 bus. It uses
	  PG2 (P2 pin 62) as its dedicated active-low chip select and is
	  exposed by the Linux AT25/NVMEM driver.

	  Find My Device stores two alternating, checksummed records in the
	  first 512 bytes. If the FRAM is absent or fails to probe, startup
	  continues with mounted storage packages and then RAM.

config BR2_PACKAGE_FIND_MY_DEVICE_FRAM_SELECTED
	bool
	default y if BR2_PACKAGE_FIND_MY_DEVICE_FRAM

config BR2_PACKAGE_FIND_MY_DEVICE_EEPROM
	bool "Enable 24LC16B I2C EEPROM"
	help
	  Enable a Microchip 24LC16B on the existing 100 kHz I2C3 bus. Linux's
	  at24 driver exposes its 2 KiB as byte-addressable NVMEM; no filesystem
	  is used. Find My Device stores two alternating 256-byte records with
	  generation counters, CRC32, and read-back verification.

	  The EEPROM occupies I2C addresses 0x50 through 0x57. It can coexist
	  with SPI-FRAM, SPI-NOR, and mounted storage, and Find My Device remains
	  the sole writer of its reserved first 512 bytes.

config BR2_PACKAGE_FIND_MY_DEVICE_SPINOR_STATE
	bool "Enable W25Q128FV SPI-NOR"
	depends on !BR2_PACKAGE_FIND_MY_DEVICE_FRAM_SELECTED
	help
	  Enable a W25Q128FV on the shared SPI5 bus and reserve its first two
	  4 KiB erase sectors for Find My Device. State is accessed directly
	  through raw MTD, without a filesystem, and written as alternating
	  records with generation counters, CRC32, and read-back verification.
	  An interrupted erase or write leaves the previous sector usable.

	  This option is independent of the standalone SPI-NOR package. If that
	  package is also selected, it exposes the remaining NOR capacity as an
	  independent JFFS2 filesystem at /mnt/spinor.

config BR2_PACKAGE_FIND_MY_DEVICE_COMPRESS_INITRAMFS
	bool "Compress the initramfs with gzip"
	help
	  Store the embedded root filesystem as a gzip-compressed archive in
	  internal flash. Linux expands it into RAM during boot; the kernel
	  remains an XIP image and continues executing directly from flash.

	  Enable this when Find My Device is combined with size-heavy packages,
	  especially SPI-NAND. The final xipImage must still fit within the
	  STM32F429's 2,048,000-byte project limit.

config BR2_PACKAGE_FIND_MY_DEVICE_CONSOLE_DEBUG
	bool "Enable console button and LED debug controls"
	help
	  Install find-my-device-debug for hardware-independent testing from
	  the serial console. Its button command simulates one complete USER
	  button press and its led command runs a three-flash LD3 self-test
	  while reporting LED state changes on the console. The net command
	  prints interface counters, and the daemon reports them every five
	  seconds so failures can be diagnosed even when console input is not
	  available.

	  Leave this disabled in production images. The daemon's debug signal
	  handlers and console messages are omitted when this option is off.

endmenu

endif
```
