## firmware/package/sleepexample/Config.in
```kconfig
config BR2_PACKAGE_SLEEPEXAMPLE
    bool "Sleep Functions Test Utility"
    help
      This package provides a simple C utility demonstrating and testing
      various Linux sleep functions on an STM32-based system.

      The utility performs interactive, serial console-friendly tests of:
        - sleep(seconds)
        - usleep(microseconds)
        - nanosleep(timespec)
        - clock_nanosleep(clockid_t, flags, timespec)

      For each test, it prints the system date/time before and after the
      sleep interval, allowing verification of proper timer and tick
      operation on the device.

      This is useful for diagnosing kernel timer issues where sleep calls
      return immediately due to missing or broken clocksource drivers.

      Dependencies:

      **Standard C library (libc)**

      **Core timekeeping (mandatory for all sleep functions):**
        - CONFIG_HIGH_RES_TIMERS=y         # High-resolution timers for sub-second sleeps
        - CONFIG_POSIX_TIMERS=y            # Required for nanosleep() and clock_nanosleep()
        - CONFIG_GENERIC_CLOCKEVENTS=y     # Basic timer interrupt handling
        - CONFIG_TICK_ONESHOT=y            # Allows precise one-shot timers
        - CONFIG_HZ=1000                   # Recommended for millisecond accuracy
        - CONFIG_CLKSRC_STM32=y            # STM32 clocksource driver
        - CONFIG_COMPAT_32BIT_TIME=y       # Syscall ABI required by the uClibc toolchain

      Selecting this package adds CONFIG_COMPAT_32BIT_TIME through a kernel
      configuration fragment. It remains disabled in the minimal image when
      this example is not selected.

      **Required for specific tests**
        - CONFIG_TIMERFD=y                 # Needed for timerfd_create() test
        - CONFIG_EPOLL=y                   # Needed for epoll_wait() test
        - CONFIG_FUTEX=y                   # Required by pthread_cond_timedwait() test (POSIX
                                           # thread waits depend on futexes)

      **Real-Time Clock (RTC), hardware clock device**
        - CONFIG_RTC_CLASS=y               # Enable RTC subsystem support in the Linux kernel
        - CONFIG_RTC_DRV_STM32=y           # Use the STM32-specific hardware RTC driver
        - /dev/rtc0                         # Accessed directly with RTC ioctls

      CONFIG_RTC_HCTOSYS, CONFIG_RTC_SYSTOHC, procfs, and kernel debugging
      facilities are not required by this example.

      Timers in embedded Linux?

       - https://www.reddit.com/r/embedded/comments/ya5tiq/timers_in_embedded_linux/
         Look at the timerfd family functions https://linux.die.net/man/2/timerfd_create
         The advantage of these compared to other types of timer is that you get a file
         descriptor for the timer that you can then use with poll/select alone with other
         fds. That makes it easy to have a single event loop that handle everything.
```

## firmware/package/spinand/Config.in
```kconfig
config BR2_PACKAGE_SPINAND
	bool "W25N02KV SPI-NAND: 32 MiB UBIFS data volume"
	depends on !BR2_PACKAGE_SDCARD
	depends on !BR2_PACKAGE_GALLERY_SDCARD
	help
	  Enable a Winbond W25N02KV on SPI5 and expose the first 32 MiB as
	  an UBI-managed UBIFS data volume. The package applies the required
	  Linux and BusyBox configuration fragments, builds a dedicated DTB,
	  and installs the spinand-ubi setup/status helper.

	  SPI5 clock and data are shared with the onboard gyroscope, LCD
	  controller, and optional W5500. SPI-NAND uses its own PG3 chip select.
	  The SD card remains isolated on SPI4. NAND is never erased or formatted
	  automatically. Run
	  "spinand-ubi format --yes" once after checking the wiring.

	  See package/spinand/README.md for wiring and first-use instructions.

if BR2_PACKAGE_SPINAND

menu "W25N02KV SPI-NAND options"

config BR2_PACKAGE_SPINAND_COMPRESS_INITRAMFS
	bool "Compress the initramfs with gzip"
	default y
	help
	  Store the embedded root filesystem as a gzip-compressed archive in
	  internal flash. Linux expands it into RAM during boot; the kernel
	  remains an XIP image and continues executing directly from flash.

	  SPI-NAND support adds MTD, UBI, UBIFS, and management utilities, so
	  compression is enabled by default to help the final xipImage stay
	  below the STM32F429 project's 2,048,000-byte limit.

config BR2_PACKAGE_SPINAND_AUTOMOUNT
	bool "Mount an initialized UBIFS volume automatically at boot"
	default y
	help
	  Probe the W25N02KV during boot, attach its UBI partition, and mount
	  the data volume at /mnt/spinand. Existing data is never erased.

	  When the NAND is detected but has no usable UBI data volume, boot
	  prints the explicit one-time initialization command:
	  "spinand-ubi format --yes". Formatting remains a manual destructive
	  action and is never performed by this option.

config BR2_PACKAGE_SPINAND_FASTMAP
	bool "Use UBI fastmap checkpoints (experimental)"
	default n
	help
	  Enable Linux CONFIG_MTD_UBI_FASTMAP and request automatic fastmap
	  creation before UBI is attached. The first attach still performs a
	  full scan and writes a checkpoint; later attaches can restore the UBI
	  mapping by reading the fastmap instead of scanning every eraseblock.

	  Linux 6.6 marks the on-flash fastmap format experimental. Fastmap also
	  reserves eraseblocks for two checkpoint copies. Back up an existing
	  volume before enabling this option: volumes created with "ubimkvol -m"
	  may need to be reformatted so those eraseblocks can be reserved.

endmenu

endif

comment "W25N02KV SPI-NAND is unavailable with SD card (storage image size)"
	depends on BR2_PACKAGE_SDCARD

comment "W25N02KV SPI-NAND is unavailable with Gallery SD support (storage image size)"
	depends on BR2_PACKAGE_GALLERY_SDCARD
```

## firmware/package/spinor/Config.in
```kconfig
config BR2_PACKAGE_SPINOR
	bool "W25Q128FV SPI-NOR: 16,376 KiB JFFS2 data volume"
	help
	  Enable a Winbond W25Q128FV on SPI5. Its first two 4 KiB erase sectors
	  are permanently reserved for raw A/B find-me records, and the
	  remaining 16,376 KiB is exposed as a JFFS2 data volume. The package
	  applies the required Linux and BusyBox configuration fragments and
	  installs the spinor-jffs2 setup/status helper.

	  SPI5 clock and data are shared with the onboard gyroscope, LCD
	  controller, W5500, and optional SPI-NAND. SPI-NOR uses its own PG2
	  chip select. The SD card remains isolated on SPI4. Initialize new media
	  once with "spinor-jffs2 format --yes" after checking the wiring.

	  See package/spinor/readme.md for wiring and first-use instructions.

if BR2_PACKAGE_SPINOR

menu "W25Q128FV SPI-NOR options"

config BR2_PACKAGE_SPINOR_COMPRESS_INITRAMFS
	bool "Compress the initramfs with gzip"
	default y
	help
	  Store the embedded root filesystem as a gzip-compressed archive in
	  internal flash. Linux expands it into RAM during boot; the kernel
	  remains an XIP image and continues executing directly from flash.

	  SPI-NOR support adds MTD, JFFS2, and management utilities, so
	  compression is enabled by default to help the final xipImage stay
	  below the STM32F429 project's 2,048,000-byte limit.

config BR2_PACKAGE_SPINOR_AUTOMOUNT
	bool "Mount an initialized JFFS2 volume automatically at boot"
	default y
	help
	  Install /etc/init.d/S10spinor. It probes the W25Q128FV during boot and
	  mounts its JFFS2 data partition at /mnt/spinor.

	  When the NOR is detected but has no usable JFFS2 filesystem, boot
	  prints the one-time initialization command:
	  "spinor-jffs2 format --yes". Formatting remains a manual destructive
	  action.

config BR2_PACKAGE_SPINOR_SUMMARY
	bool "Enable JFFS2 summary nodes for faster mounts"
	default n
	help
	  Enable CONFIG_JFFS2_SUMMARY. Summary nodes compact each eraseblock's
	  node index so later mounts can scan less metadata. Existing JFFS2
	  filesystems remain compatible; summaries are added as blocks are
	  written or garbage-collected.

	  This adds some kernel code and on-flash metadata. Keep it disabled
	  when minimum internal-flash image size matters more than mount time.

endmenu

endif
```

## firmware/package/sysdiag/Config.in
```kconfig
config BR2_PACKAGE_SYSDIAG
	bool "sysdiag"
	help
	  Install the sysdiag diagnostic command and enable reusable kernel
	  and BusyBox diagnostics. The report includes system information,
	  interrupts, clocks, device nodes, and kernel messages. When the LTDC
	  driver is present, it also reports display clocks and registers.

	  This package is independent of every example. Select it temporarily
	  beside whichever example is being debugged, then disable it to produce
	  the smaller normal image.
```

## firmware/package/usb-cdc/Config.in
```kconfig
config BR2_PACKAGE_USB_CDC
	bool "USB CDC ACM data-port example"
	help
	  Configure the STM32F429 Discovery USB USER connector as a CDC ACM
	  serial device. The connector uses the OTG HS controller's internal
	  full-speed PHY. On the host it normally appears as /dev/ttyACM0;
	  on the board it is /dev/ttyGS0.

	  USART1 remains the Linux console. Use ttyGS0 as an independent data
	  port for manual transfers or run usb-cdc to echo host data back.
	  Connect the host to the board's USB USER micro-AB connector, not the
	  ST-LINK USB connector.
```
