## firmware/package/gallery/Config.in
```kconfig
config BR2_PACKAGE_GALLERY_PROVIDES_DISPLAY
	bool

config BR2_PACKAGE_GALLERY
	bool "Gallery: PNG/JPEG/GIF/BMP slideshow"
	depends on !BR2_PACKAGE_FIRMWARE_SCREEN
	select BR2_PACKAGE_GALLERY_PROVIDES_DISPLAY
	select BR2_PACKAGE_FBV
	select BR2_PACKAGE_FBV_PNG
	select BR2_PACKAGE_FBV_JPEG
	select BR2_PACKAGE_FBV_GIF
	help
	  Install the Display slideshow as one BusyBox-style executable with
	  gallery, display, and display-pattern applet names. Its optional
	  features add automatic startup and SD-card image support.

	  By default Gallery uses only its embedded images. Optional SD-card
	  support adds the automounter applet and the required MMC/FAT kernel
	  configuration to the same image.

	  Selecting Gallery disables the standalone Display example. The
	  standalone SD-card package may coexist while Gallery's built-in SD
	  support is disabled. Enabling built-in support disables the standalone
	  package so that the sdcard command has exactly one owner.

comment "Gallery is disabled by Screen"
	depends on BR2_PACKAGE_FIRMWARE_SCREEN

if BR2_PACKAGE_GALLERY

menu "Gallery options"

config BR2_PACKAGE_GALLERY_COMPRESS_INITRAMFS
	bool "Compress the initramfs with gzip (NEW)"
	default y
	help
	  Store the embedded root filesystem as a gzip-compressed archive in
	  internal flash. Linux expands it into RAM during boot; the kernel
	  remains an XIP image and continues executing directly from flash.

config BR2_PACKAGE_GALLERY_AUTOSTART
	bool "Start the gallery automatically at boot"
	default y
	help
	  Install the package-owned /etc/init.d/S30gallery service and start the
	  non-interactive slideshow at boot.

config BR2_PACKAGE_GALLERY_SDCARD
	bool "Build SD-card support into the Gallery executable"
	help
	  Link the sdcard applet into Gallery and add MMC-over-SPI/FAT support
	  and the automount service.
	  This disables the standalone SD-card package because both packages
	  would otherwise install /usr/sbin/sdcard.

	  This option is disabled by default so the basic Gallery example has
	  no SD-card runtime or storage-stack dependency.

if BR2_PACKAGE_GALLERY_SDCARD

config BR2_PACKAGE_GALLERY_SDCARD_IMAGES
	bool "Use images from an automatically mounted SD card"
	help
	  Prefer supported images in the root of /mnt/sdcard when it is mounted
	  and contains images. Fall back to the embedded images otherwise.

	  Leave this disabled to demonstrate the built-in SD-card applet while
	  keeping the slideshow source fixed at /usr/share/display.

endif

endmenu

endif
```

## firmware/package/hello-c/Config.in
```kconfig
config BR2_PACKAGE_HELLO_C
	bool "hello-c"
	help
	  Build the C Makefile and configuration-file teaching project.
```

## firmware/package/hello-cpp/Config.in
```kconfig
config BR2_PACKAGE_HELLO_CPP
	bool "hello-cpp"
	depends on BR2_INSTALL_LIBSTDCPP
	help
	  Build the C++ Makefile and configuration-file teaching project.

comment "hello-cpp requires C++ support in the toolchain"
	depends on !BR2_INSTALL_LIBSTDCPP
```

## firmware/package/hwtools/Config.in
```kconfig
config BR2_PACKAGE_HWTOOLS
	bool "Hardware tools"
	help
	  Build a BusyBox-style multicall executable containing selected
	  STM32F429Discovery hardware examples. Each selected applet is also
	  installed under its own descriptive command name.

if BR2_PACKAGE_HWTOOLS

menu "Hardware tools"

config BR2_PACKAGE_HWTOOLS_GPIO_LED
	bool "gpio-led"
	help
	  Interactively control the red PG14 LED through the Linux GPIO
	  character-device v2 API.

config BR2_PACKAGE_HWTOOLS_BUTTON_LED
	bool "button-led"
	help
	  Mirror the PA0 user-button state to the green PG13 LED using the
	  Linux GPIO character-device v2 API.

config BR2_PACKAGE_HWTOOLS_BOOT_BUTTON
	bool "boot-button"
	help
	  Report whether the PA0 user button was pressed when AFBOOT started.
	  The bootloader passes the sampled state to Linux in the device tree's
	  /chosen node.

config BR2_PACKAGE_HWTOOLS_ADC_READ
	bool "adc-read"
	help
	  Read the STM32 ADC1 channel 13 input on PC3, exposed at P2 pin 13,
	  through the Linux IIO sysfs interface.

config BR2_PACKAGE_HWTOOLS_I2C_SCAN
	bool "i2c-scan"
	select BR2_PACKAGE_PERIPHERY
	help
	  Scan /dev/i2c-0 for responding 7-bit I2C devices using c-periphery.

config BR2_PACKAGE_HWTOOLS_SPI_GYRO
	bool "spi-gyro"
	select BR2_PACKAGE_PERIPHERY
	help
	  Read the onboard I3G4250D gyroscope and temperature sensor over SPI.

config BR2_PACKAGE_HWTOOLS_RCC_CLOCK
	bool "rcc-clock"
	select BR2_PACKAGE_PERIPHERY
	help
	  Read STM32 RCC registers through /dev/mem and report clock settings.

config BR2_PACKAGE_HWTOOLS_PWM_LED
	bool "pwm-led"
	select BR2_PACKAGE_PERIPHERY
	help
	  Interactively control a LED on TIM3_CH1/PB4 through Linux PWM sysfs.

config BR2_PACKAGE_HWTOOLS_UART_SEND
	bool "uart-send"
	select BR2_PACKAGE_PERIPHERY
	help
	  Send text interactively through UART5, defaulting to /dev/ttySTM1.

config BR2_PACKAGE_HWTOOLS_RS485_CHAT
	bool "rs485-chat"
	help
	  Exercise Linux UART RS-485 mode, defaulting to /dev/ttySTM1.

config BR2_PACKAGE_HWTOOLS_TIMERS
	bool "timers"
	help
	  Run timer, sleep, polling, system-clock, and RTC diagnostics.

endmenu

endif
```

## firmware/package/ioexample1/Config.in
```kconfig
config BR2_PACKAGE_IOEXAMPLE1
    bool "Example1: LED control with GPIO cdev v2"
    help
      This package provides an example C application that demonstrates
      controlling the red PG14 LED using the Linux GPIO character device.

      The application allows interactive control over the LED state via
      standard input. The user can turn the LED ON or OFF or quit the
      application by entering 1, 0, or q respectively.
```

## firmware/package/ioexample2/Config.in
```kconfig
config BR2_PACKAGE_IOEXAMPLE2
    bool "Example2: Button-controlled LED with GPIO cdev v2"
    help
      This package demonstrates GPIO input and output through the Linux
      GPIO character-device v2 API.

      The program configures one GPIO line as input (e.g., connected to the
      STM32F429 Discovery board's user button) and another GPIO line as output
      (e.g., connected to the red LED). It continuously reads the button state
      and reflects it directly on the unclaimed green LED GPIO: the LED turns ON when the button is
      pressed and OFF otherwise.

      The loop runs until the user presses any key in the terminal.
```

## firmware/package/ioexample6/Config.in
```kconfig
config BR2_PACKAGE_IOEXAMPLE6
    bool "Example6: PWM Interactive Demo (TIM3_CH1, PB4)"
    select BR2_PACKAGE_PERIPHERY
    help
      This package provides a simple utility demonstrating the usage of
      the Linux PWM sysfs interface on an STM32F4-based board.

      It enables PWM output on chip0, channel0 (TIM3_CH1, PB4). The user can
      enter any integer duty cycle from 0 to 100 percent, or q to quit.

      Connect an external LED in series with a 330-680 ohm resistor between
      PB4 and GND. The onboard LEDs on PG13 and PG14 do not expose timer PWM
      alternate functions on STM32F429.

      The example shows:
        - Opening and configuring a PWM channel
        - Setting frequency and duty cycle
        - Enabling/disabling PWM output
        - Basic user interaction for testing LED brightness or signal levels

      Dependencies:
        https://github.com/vsergeev/c-periphery
```

## firmware/package/ioexample7/Config.in
```kconfig
config BR2_PACKAGE_IOEXAMPLE7
    bool "Example7: Serial Interactive Demo (UART communication)"
    select BR2_PACKAGE_PERIPHERY
    help
      This package provides a simple utility demonstrating the usage of
      the Linux serial interface on an STM32F4-based board.

      It opens a specified serial port (default: /dev/ttySTM1) configured
      for 115200 8N1, no flow control, and allows interactive user input
      from the terminal.

      The example shows:
        - Opening and configuring a serial port
        - Sending messages typed by the user
        - Handling empty input to exit gracefully
        - Basic interaction for testing UART communication

      Dependencies:
        https://github.com/vsergeev/c-periphery

      Selecting this example builds and flashes the USART3-enabled board
      device tree. It cannot be combined with displayexample because USART3
      and LTDC share PB10/PB11.
```

## firmware/package/networking/Config.in
```kconfig
config BR2_PACKAGE_NETWORKING
	bool "Networking"
	help
	  Enable the kernel and BusyBox networking stack. Select the network
	  controller in the Networking options submenu.

if BR2_PACKAGE_NETWORKING

menu "Networking options"

config BR2_PACKAGE_NETWORKING_W5500
	bool "W5500 Ethernet controller"
	default y
	help
	  Enable the W5500 on shared SPI5 using PD5 as chip select and PE3 as
	  its interrupt input. The SD card remains on SPI4.

endmenu

endif
```

## firmware/package/periphery/Config.in
```kconfig
config BR2_PACKAGE_PERIPHERY
	bool
	help
	  Local c-periphery static library used by the hardware examples.
	  Examples select this package automatically when they need it.
```

## firmware/package/pn7150/Config.in
```kconfig
menuconfig BR2_PACKAGE_NFC
	bool "NFC"
	help
	  Enable NFC controller examples and their related options.

if BR2_PACKAGE_NFC

menuconfig BR2_PACKAGE_PN7150
	bool "NXP PN7150 demo"
	help
	  Build pn7150-demo, a board-specific PN7150/OM5578 initialization,
	  tag-discovery, and NDEF-reading example. It ports NXP's SW4325
	  Cortex-M NCI/NDEF library to Linux I2C3 and GPIO character devices.
	  PC8 is VEN and PB7 is IRQ. NCI frames are printed for bring-up.

	  Download SW4325.zip from NXP after accepting its license and place
	  it in the workspace root. The restricted vendor source is consumed
	  locally and is not redistributed by this package.

	  PN7150 uses I2C, not SPI; no chip-select signal is required.

if BR2_PACKAGE_PN7150

config BR2_PACKAGE_PN7150_IRQ_POLLING_FALLBACK
	bool "10 ms IRQ polling fallback"
	help
	  Keep Linux GPIO rising-edge events as the primary IRQ mechanism,
	  but sample the IRQ level whenever an event has not arrived within
	  10 ms. This provides a fallback on STM32 GPIO/EXTI configurations
	  that accept an edge-event request but do not deliver the event.
	  Leave this disabled for normal interrupt-driven operation.

endif

endif
```

## firmware/package/screen/Config.in
```kconfig
config BR2_PACKAGE_FIRMWARE_SCREEN
	bool "Screen: touch console with on-screen keyboard"
	depends on !BR2_PACKAGE_SCREEN
	help
	  Enable the STM32F429Discovery LCD and STMPE811 touchscreen and
	  install a small framebuffer terminal as /usr/bin/screen. Screen
	  starts an interactive BusyBox shell on a private PTY; the USART
	  serial shell remains the recovery and diagnostic console.

	  This example directly owns /dev/fb0 and cannot run with the Display
	  or Gallery examples. It is unrelated to the GNU Screen package.

comment "Screen is disabled by GNU Screen (/usr/bin/screen conflict)"
	depends on BR2_PACKAGE_SCREEN

if BR2_PACKAGE_FIRMWARE_SCREEN

menu "Screen options"

config BR2_PACKAGE_FIRMWARE_SCREEN_COMPRESS_INITRAMFS
	bool "Compress the initramfs with gzip (NEW)"
	default y
	help
	  Store the embedded root filesystem as a gzip-compressed archive in
	  internal flash. Linux expands it into RAM during boot; the kernel
	  remains an XIP image and continues executing directly from flash.

config BR2_PACKAGE_FIRMWARE_SCREEN_AUTOSTART
	bool "Start the touch console automatically at boot"
	default y
	help
	  Install the package-owned /etc/init.d/S30screen service. It starts a
	  supervisor which waits for both /dev/fb0 and the STMPE811 evdev device
	  before launching the LCD shell.

endmenu

endif
```

## firmware/package/sdcard/Config.in
```kconfig
config BR2_PACKAGE_SDCARD
	bool "SD card adapter: SPI-mode FAT storage"
	depends on !BR2_PACKAGE_GALLERY_SDCARD
	help
	  Enable a removable SD/SDHC card adapter on SPI4 and mount its first
	  FAT16/FAT32 partition at /mnt/sdcard. The package applies the Linux
	  and BusyBox configuration fragments and installs the sdcard
	  status/mount helper.

	  The display-safe wiring uses PE2, PE4, PE5, and PE6 on expansion
	  header P1. It may be selected with find-me; the SD card stays on SPI4
	  while the
	  W5500 uses the separate SPI5 controller. Select Gallery and its
	  SD-card suboption to combine the SD-card and Display applets in one
	  executable.

	  See package/sdcard/readme.md for wiring and usage instructions.

if BR2_PACKAGE_SDCARD

menu "SD card options"

config BR2_PACKAGE_SDCARD_AUTOMOUNT
	bool "Mount an inserted SD card automatically at boot"
	default y
	help
	  Install the package-owned /etc/init.d/S20sdcard service and try to
	  mount a card during boot. If periodic detection is disabled, this is a
	  single mount attempt; a card inserted later must be mounted manually
	  with "sdcard mount".

config BR2_PACKAGE_SDCARD_AUTODETECT
	bool "Periodically detect and automatically mount SD cards"
	default y
	depends on BR2_PACKAGE_SDCARD_AUTOMOUNT
	help
	  Make sdcard-auto run the continuous watcher instead of performing a
	  single mount attempt. The watcher checks once per second, mounts a
	  newly inserted card, and detaches a stale mount after card removal.

	  Disable this to mount only a card that is already present at boot.

endmenu

endif

comment "Standalone SD card is disabled by Gallery's built-in SD support"
	depends on BR2_PACKAGE_GALLERY_SDCARD
```
