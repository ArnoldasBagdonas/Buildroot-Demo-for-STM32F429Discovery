## firmware/configs/stm32f429disco.defconfig
```kconfig
BR2_arm=y
BR2_cortex_m4=y
BR2_TOOLCHAIN_EXTERNAL=y
BR2_TOOLCHAIN_EXTERNAL_CUSTOM=y
BR2_TOOLCHAIN_EXTERNAL_DOWNLOAD=y
BR2_TOOLCHAIN_EXTERNAL_URL="file:///workspace/buildroot-sdk/arm-buildroot-uclinux-uclibcgnueabi_sdk-buildroot.tar.gz"
BR2_TOOLCHAIN_EXTERNAL_HEADERS_6_1=y
# BR2_TOOLCHAIN_EXTERNAL_HAS_THREADS_DEBUG is not set
# BR2_TOOLCHAIN_EXTERNAL_HAS_THREADS_NPTL is not set
BR2_TOOLCHAIN_EXTERNAL_CXX=y
BR2_ENABLE_LTO=y
BR2_ROOTFS_POST_BUILD_SCRIPT="board/stmicroelectronics/common/stm32f4xx/stm32-post-build.sh"
BR2_LINUX_KERNEL=y
BR2_LINUX_KERNEL_CUSTOM_VERSION=y
BR2_LINUX_KERNEL_CUSTOM_VERSION_VALUE="6.1.27"
BR2_LINUX_KERNEL_USE_CUSTOM_CONFIG=y
BR2_LINUX_KERNEL_CUSTOM_CONFIG_FILE="/workspace/firmware/board/stm32f429disco/linux.config"
BR2_LINUX_KERNEL_IMAGE_TARGET_CUSTOM=y
BR2_LINUX_KERNEL_IMAGE_TARGET_NAME="xipImage"
BR2_LINUX_KERNEL_DTS_SUPPORT=y
BR2_LINUX_KERNEL_INTREE_DTS_NAME="stm32f429-disco"
BR2_LINUX_KERNEL_CUSTOM_DTS_PATH="/workspace/firmware/board/stm32f429disco/dts/stm32f429disco-custom.dts"
BR2_PACKAGE_BUSYBOX_CONFIG="/workspace/firmware/board/stm32f429disco/busybox.config"
# BR2_PACKAGE_IFUPDOWN_SCRIPTS is not set
BR2_TARGET_ROOTFS_INITRAMFS=y
# BR2_TARGET_ROOTFS_TAR is not set
BR2_TARGET_AFBOOT_STM32=y
BR2_TARGET_AFBOOT_STM32_KERNEL_ADDR=0x0800C000
BR2_PACKAGE_HOST_OPENOCD=y
BR2_PACKAGE_IOEXAMPLE6=y
```

## firmware/package/buttonlistener/Config.in
```kconfig
config BR2_PACKAGE_BUTTONLISTENER
    bool "GPIO button listener example"
    help
      This is a simple application that listens for button press events
      from gpio-keys via /dev/input/eventX, and can be used to trigger
      actions such as toggling an LED using the /sys/class/leds interface.
```

## firmware/package/gpiodevent/Config.in
```kconfig
config BR2_PACKAGE_GPIODEVENT
    bool "libgpiod event example"
    select BR2_PACKAGE_LIBGPIOD
    help
      This is an event (triggered from interrupt) example application using libgpiod.
      It can be compiled and executed on Linux systems with GPIO support.
```

## firmware/package/gpiodio/Config.in
```kconfig
config BR2_PACKAGE_GPIODIO
    bool "libgpiod input/output example"
    select BR2_PACKAGE_LIBGPIOD
    help
      This is an input/output application with libgpiod.
      It can be compiled and executed on Linux system if there is GPIO.
```

## firmware/package/hellomk/Config.in
```kconfig
config BR2_PACKAGE_HELLOMK
    bool "Hello Makefile"
    help
      This is a sample configuration for the Hello Makefile package.
```

## firmware/package/hellomkcpp/Config.in
```kconfig
config BR2_PACKAGE_HELLOMKCPP
    bool "Hello Makefile C++"
    help
      This is a sample configuration for the Hello Makefile C++ package.
```

## firmware/package/ioexample3/Config.in
```kconfig
config BR2_PACKAGE_IOEXAMPLE3
    bool "Example3: I2C Bus Scanner using c-periphery"
    help
      This package provides a C application example using the c-periphery
      library to demonstrate scanning the I2C bus for connected devices.

      The program opens a specified I2C bus (e.g., /dev/i2c-2) and attempts
      zero-length transfers to all valid 7-bit I2C addresses (0x03 to 0x77),
      printing detected device addresses to stdout.

      This is useful for debugging or discovering devices on the I2C bus.

      This example uses:
        https://github.com/vsergeev/c-periphery
```

## firmware/package/ioexample4/Config.in
```kconfig
config BR2_PACKAGE_IOEXAMPLE4
    bool "Example4: SPI Temperature Read from I3G4250D using c-periphery"
    help
      This package provides a C application example using the c-periphery
      library to demonstrate reading the temperature register from the
      ST I3G4250D gyroscope over SPI.

      The program opens the specified SPI device (e.g., /dev/spidev5.0),
      enables the sensor by writing to CTRL_REG1, then reads the OUT_TEMP
      register (0x26) and prints the raw and signed temperature value to stdout.

      The chip select (CS) line is configured via Device Tree using cs-gpios
      and is automatically handled by the Linux SPI driver.

      This example uses:
        https://github.com/vsergeev/c-periphery
```

## firmware/package/ioexample5/Config.in
```kconfig
config BR2_PACKAGE_IOEXAMPLE5
    bool "Example5: RCC Frequency Reader"
    help
      This package provides a simple utility that reads the STM32F4 RCC
      (Reset and Clock Control) registers directly from `/dev/mem` to
      detect and display the current system clock (SYSCLK) frequency.
      
      It demonstrates low-level hardware register mapping and direct
      memory access on STM32 microcontrollers running Linux.

      This example uses:
        https://github.com/vsergeev/c-periphery
```

## firmware/package/ioexample8/Config.in
```kconfig
config BR2_PACKAGE_IOEXAMPLE8
    bool "Example8: Serial RS-485 Interactive Demo"
    help
      This package provides a simple interactive demo that configures and
      communicates over a serial RS-485 interface (e.g., /dev/ttySTM1) on
      an STM32F4-based board.

      Features:
        - Opens and configures a serial port at 115200 baud (8N1)
        - Enables RS-485 mode via ioctl (TIOCSRS485)
        - Sends user-typed messages from the terminal
        - Waits for transmission completion (tcdrain)
        - Gracefully exits on empty input
        - (Optional) Receives responses with a 100ms timeout

      Usage:
        $ ioexample8 [<tty device>]
        Defaults to /dev/ttySTM1 if not specified.

      Dependencies:
        - Standard Linux serial interface
        - <linux/serial.h>, termios, ioctl
        - https://github.com/vsergeev/c-periphery (reference)

      Example:
        $ ioexample8 /dev/ttySTM1

      Note:
        The program uses VMIN/VTIME settings for blocking read with timeout.
        RS-485 flags are configured as:
          - SER_RS485_ENABLED
          - SER_RS485_RTS_ON_SEND
          - ~SER_RS485_RTS_AFTER_SEND

      This demo is useful for verifying UART/RS-485 wiring and behavior.
```

## firmware/package/ledbrightness/Config.in
```kconfig
config BR2_PACKAGE_LEDBRIGHTNESS
    bool "ledbrightness /sys/class/leds example"
    help
      This is an LED control application with /sys/class/leds.
```
