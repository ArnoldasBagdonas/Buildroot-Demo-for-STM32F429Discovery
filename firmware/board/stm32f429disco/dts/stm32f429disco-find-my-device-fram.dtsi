/* Optional Cypress CY15B256Q storage for Find My Device. */
#include "stm32f429disco-find-my-device.dtsi"

&spi5 {
	/*
	 * CS0: gyroscope; CS1: LCD; CS2: W5500; CS3: SPI-NAND;
	 * CS4: CY15B256Q FRAM.
	 */
	cs-gpios = <&gpioc 1 GPIO_ACTIVE_LOW>,
		     <&gpioc 2 GPIO_ACTIVE_LOW>,
		     <&gpiod 5 GPIO_ACTIVE_LOW>,
		     <&gpiog 3 GPIO_ACTIVE_LOW>,
		     <&gpiog 2 GPIO_ACTIVE_LOW>;

	fram: fram@4 {
		compatible = "cypress,fm25", "atmel,at25";
		reg = <4>;
		spi-max-frequency = <10000000>;
	};
};
